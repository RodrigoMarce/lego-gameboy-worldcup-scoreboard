/*
  LEGO Game Boy -- World Cup live scoreboard  v5
  ------------------------------------------------------------
  Brain   : ESP32 (WROOM-32 dev board with Wi-Fi)
  Display : 2.4" ILI9341 240x320 SPI panel, landscape (320x240)
  Data    : ESPN's public (unofficial) World Cup scoreboard JSON

  Libraries: TFT_eSPI by Bodmer, ArduinoJson by Benoit Blanchon (v6.x)
  Board:     esp32 by Espressif
*/

#include <WiFi.h>
#include <HTTPClient.h>
#define ARDUINOJSON_DEFAULT_NESTING_LIMIT 15
#include <ArduinoJson.h>
#include <TFT_eSPI.h>
#include <time.h>
#include "config.h"   // copy config.h.example -> config.h and fill in your Wi-Fi + timezone

// ---------------- user settings ----------------
// Wi-Fi credentials and timezone now live in config.h (gitignored, kept private).
// See config.h.example for the template.

const uint32_t FETCH_EVERY_MS  = 60000;
const uint32_t ROTATE_EVERY_MS = 5000;

// Set to true to fire the goal animation once on boot for testing.
// Change to false when you're happy with how it looks.
#define TEST_ANIMATION false
// ------------------------------------------------

// Game Boy DMG palette — RGB565
#define GB_BG    0x09C1   // #0f380f  background
#define GB_DARK  0x1183   // #0a2a0a  panel background
#define GB_DIM2  0x4C87   // #4a8a38  secondary text
#define GB_INK   0x9DE1   // #9bbc0f  primary text / scores

// Screen dimensions (landscape)
#define SCR_W 320
#define SCR_H 240

// Layout constants
#define HDR_H    24
#define PANEL_Y  26
#define PANEL_H  114
#define SCORER_Y 142
#define SCORER_H 72
#define FOOTER_Y 216
#define FOOTER_H 24

// Goal net bitmap — drawn by hand in Piskel, transcribed pixel-for-pixel.
// 2 bits per pixel: 0 = transparent, 1 = net mesh, 2 = bright post.
#define NET_W   123
#define NET_H   75
// 2 bits/pixel: 0=transparent 1=net 2=post  (2307 bytes)
static const uint8_t NET_BMP[] = {
  0xAA,0xAA,0xAA,0xAA,0xAA,0xAA,0xAA,0xAA,0xAA,0xAA,0xAA,0xAA,0xAA,0xAA,0xAA,0xAA,
  0xAA,0xAA,0xAA,0xAA,0xAA,0xAA,0xAA,0xAA,0xA0,0x00,0x00,0x00,0x00,0x00,0x02,0xAA,
  0xAA,0xAA,0xAA,0xAA,0xAA,0xAA,0xAA,0xAA,0xAA,0xAA,0xAA,0xAA,0xAA,0xAA,0xAA,0xAA,
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  0xAA,0xAA,0x80,
};

// Where to place the net on screen (top-left corner)
#define NET_DX  (SCR_W - NET_W - 6)   // right side, 6px margin
#define NET_DY  34                     // just below the header
#define NET_X   NET_DX                 // alias used by the animation erase test

TFT_eSPI    tft  = TFT_eSPI();
TFT_eSprite ball = TFT_eSprite(&tft);
TFT_eSprite netSpr = TFT_eSprite(&tft);   // pre-rendered net for flicker-free redraw

// ── Data model ───────────────────────────────────────────────────────────────
#define MAX_SCORERS 10

struct Match {
  char homeName[24];
  char awayName[24];
  char homeScore[4];
  char awayScore[4];
  char clock[16];       // e.g. "63'", "HT", "FT", "1:00 PM EDT"
  char group[16];
  char venue[40];
  bool live;
  bool finished;
  bool scheduled;
  char scorerName[MAX_SCORERS][22];
  char scorerTime[MAX_SCORERS][8];
  bool scorerHome[MAX_SCORERS];
  int  scorerCount;
  int  prevHomeScore;
  int  prevAwayScore;
};

Match    matches[16];
int      matchCount = 0;
int      showIdx    = 0;
uint32_t lastFetch  = 0;
uint32_t lastRotate = 0;

// ── Arc path precomputed ──────────────────────────────────────────────────────
#define ARC_STEPS 28
static int16_t arcX[ARC_STEPS];
static int16_t arcY[ARC_STEPS];

void precomputeArc() {
  float x0 = 4,   y0 = SCR_H / 2 + 20;   // start: far left, lower
  float x1 = NET_DX + 18, y1 = NET_DY + 30;   // land inside the goal mouth
  float peak = 80.0f;
  for (int i = 0; i < ARC_STEPS; i++) {
    float t  = (float)i / (ARC_STEPS - 1);
    arcX[i] = (int16_t)(x0 + t * (x1 - x0));
    arcY[i] = (int16_t)(y0 + (y1 - y0) * t - peak * 4.0f * t * (1.0f - t));
  }
}

// ── 32×32 ball pixel art ──────────────────────────────────────────────────────
// 0 = transparent, 1 = black pentagon, 2 = white
// Extracted from the reference image
static const uint8_t BALL[32][32] = {
  {0,0,0,0,0,0,0,0,0,0,0,0,0,0,0,0,0,0,0,0,0,0,0,0,0,0,0,0,0,0,0,0},
  {0,0,0,0,0,0,0,0,0,0,0,0,0,0,0,0,0,0,0,0,0,0,0,0,0,0,0,0,0,0,0,0},
  {0,0,0,0,0,0,0,0,0,0,0,1,1,1,1,1,1,1,1,1,1,0,0,0,0,0,0,0,0,0,0,0},
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  {0,0,0,0,0,0,0,0,0,0,0,0,0,0,0,0,0,0,0,0,0,0,0,0,0,0,0,0,0,0,0,0},
};


// Render the 32x32 ball into the sprite at 2x scale (64x64).
// Background is the chosen transparent colour so rotation corners blend in.
void drawBallSprite() {
  ball.fillSprite(TFT_TRANSPARENT);
  for (int row = 0; row < 32; row++) {
    for (int col = 0; col < 32; col++) {
      uint8_t px = BALL[row][col];
      uint16_t c;
      if      (px == 1) c = TFT_BLACK;
      else if (px == 2) c = GB_INK;
      else continue;
      // 2x: draw a 2x2 block
      ball.fillRect(col * 2, row * 2, 2, 2, c);
    }
  }
}

// ── Draw the hand-drawn net bitmap ───────────────────────────────────────────
// bulge isn't used for the bitmap net (kept for call-compatibility); on a goal
// we just flash the posts brighter instead.
void drawNet(bool bulge) {
  for (int y = 0; y < NET_H; y++) {
    for (int x = 0; x < NET_W; x++) {
      int idx = y * NET_W + x;
      int byteIdx = idx >> 2;            // 4 px per byte
      int shift   = (3 - (idx & 3)) * 2; // 2 bits per px
      uint8_t v = (NET_BMP[byteIdx] >> shift) & 0x03;
      if (v == 0) continue;             // transparent
      uint16_t c = (v == 2) ? GB_INK : GB_DIM2;
      tft.drawPixel(NET_DX + x, NET_DY + y, c);
    }
  }
}

// Render the net bitmap once into netSpr. Transparent pixels become GB_BG so the
// sprite can be pushed opaquely over the green pitch and blend seamlessly — one
// fast block transfer per frame instead of thousands of drawPixel calls.
void renderNetSprite() {
  netSpr.createSprite(NET_W, NET_H);
  netSpr.setColorDepth(16);
  netSpr.fillSprite(GB_BG);
  for (int y = 0; y < NET_H; y++) {
    for (int x = 0; x < NET_W; x++) {
      int idx = y * NET_W + x;
      uint8_t v = (NET_BMP[idx >> 2] >> ((3 - (idx & 3)) * 2)) & 0x03;
      if (v == 0) continue;
      netSpr.drawPixel(x, y, (v == 2) ? GB_INK : GB_DIM2);
    }
  }
}
// ── Goal animation ────────────────────────────────────────────────────────────
void playGoalAnimation(const char* scorerName) {
  // Act 1: ball arcs over a clean "pitch" (uniform bg so erases are seamless)
  tft.fillScreen(GB_BG);
  // simple pitch ground line across the lower third
  tft.drawFastHLine(0, SCR_H - 60, SCR_W, GB_DIM2);
  renderNetSprite();                 // build the net sprite once
  netSpr.pushSprite(NET_DX, NET_DY); // initial net draw

  ball.createSprite(64, 64);
  ball.setColorDepth(16);
  ball.setPivot(32, 32);            // rotate around the centre
  drawBallSprite();                 // render once; we just rotate it each step

  int   prevCx = arcX[0], prevCy = arcY[0];
  float angle  = 0;
  const int ERASE = 96;             // erase box big enough for a rotated 64x64

  for (int i = 0; i < ARC_STEPS; i++) {
    int cx = arcX[i] + 32;          // sprite centre x (arc stores top-left-ish)
    int cy = arcY[i] + 32;          // sprite centre y

    // Erase a generous square at the previous centre
    tft.fillRect(prevCx + 32 - ERASE/2, prevCy + 32 - ERASE/2,
                 ERASE, ERASE, GB_BG);
    // Redraw the pitch ground line where the erase box crossed it
    tft.drawFastHLine(prevCx + 32 - ERASE/2, SCR_H - 60, ERASE, GB_DIM2);
    // Redraw the net (fast sprite push) wherever the erase box reached it
    if (prevCx + 32 + ERASE/2 >= NET_DX) netSpr.pushSprite(NET_DX, NET_DY);

    // Draw the ball rotated about its pivot, centred at (cx, cy).
    // pushRotated places the sprite's pivot at the TFT's pivot point,
    // so set the TFT pivot to the desired centre first.
    tft.setPivot(cx, cy);
    ball.pushRotated(angle, TFT_TRANSPARENT);

    prevCx = arcX[i];
    prevCy = arcY[i];
    angle += 28;                     // spin ~28 deg per step
    delay(80);
  }

  ball.deleteSprite();

  // Act 2: net "shake" — quick erase + re-push to suggest the ball hitting it
  tft.fillRect(prevCx + 32 - ERASE/2, prevCy + 32 - ERASE/2, ERASE, ERASE, GB_BG);
  netSpr.pushSprite(NET_DX, NET_DY);     delay(80);
  netSpr.pushSprite(NET_DX + 2, NET_DY); delay(120);
  netSpr.pushSprite(NET_DX, NET_DY);     delay(80);
  netSpr.pushSprite(NET_DX + 2, NET_DY); delay(120);
  netSpr.deleteSprite();                 // free the ~18KB now that Act 1-2 are done

  // Screen flash
  tft.fillScreen(GB_INK);  delay(60);
  tft.fillScreen(GB_BG);   delay(40);
  tft.fillScreen(GB_INK);  delay(60);
  tft.fillScreen(GB_BG);   delay(40);

  // Act 3: GOAL! + scorer name pulses
  tft.fillScreen(GB_DARK);
  for (int pulse = 0; pulse < 3; pulse++) {
    tft.setTextDatum(MC_DATUM);
    tft.setTextColor(GB_INK, GB_DARK);
    tft.drawString("GOAL!", SCR_W / 2, SCR_H / 2 - 24, 7);
    tft.setTextColor(GB_DIM2, GB_DARK);
    tft.drawString(scorerName, SCR_W / 2, SCR_H / 2 + 40, 4);
    delay(420);

    tft.setTextColor(GB_DIM2, GB_DARK);
    tft.drawString("GOAL!", SCR_W / 2, SCR_H / 2 - 24, 7);
    tft.setTextColor(GB_INK, GB_DARK);
    tft.drawString(scorerName, SCR_W / 2, SCR_H / 2 + 40, 4);
    delay(420);
  }
  delay(600);
}

// ── Strip diacritics ──────────────────────────────────────────────────────────
void stripDiacritics(char* str) {
  unsigned char* s = (unsigned char*)str;
  unsigned char* d = s;
  while (*s) {
    if (s[0] == 0xC3 && s[1] != 0) {
      unsigned char b = s[1];
      char rep = '?';
      if      (b >= 0x80 && b <= 0x86) rep = 'A';
      else if (b == 0x87)               rep = 'C';
      else if (b >= 0x88 && b <= 0x8B) rep = 'E';
      else if (b >= 0x8C && b <= 0x8F) rep = 'I';
      else if (b == 0x90)               rep = 'D';
      else if (b == 0x91)               rep = 'N';
      else if (b >= 0x92 && b <= 0x96) rep = 'O';
      else if (b == 0x98)               rep = 'O';
      else if (b >= 0x99 && b <= 0x9C) rep = 'U';
      else if (b == 0x9D)               rep = 'Y';
      else if (b >= 0xA0 && b <= 0xA6) rep = 'a';
      else if (b == 0xA7)               rep = 'c';
      else if (b >= 0xA8 && b <= 0xAB) rep = 'e';
      else if (b >= 0xAC && b <= 0xAF) rep = 'i';
      else if (b == 0xB1)               rep = 'n';
      else if (b >= 0xB2 && b <= 0xB6) rep = 'o';
      else if (b == 0xB8)               rep = 'o';
      else if (b >= 0xB9 && b <= 0xBC) rep = 'u';
      else if (b == 0xBD || b == 0xFF)  rep = 'y';
      *d++ = (unsigned char)rep;
      s += 2;
    } else if (s[0] >= 0x80) {
      s++;
      while (*s >= 0x80 && *s < 0xC0) s++;
    } else {
      *d++ = *s++;
    }
  }
  *d = '\0';
}

// ── NTP ───────────────────────────────────────────────────────────────────────
void syncTime() {
  configTime(GMT_OFFSET_SEC, DST_OFFSET_SEC, "pool.ntp.org");
  struct tm timeinfo;
  int tries = 0;
  Serial.print("Syncing time");
  while (!getLocalTime(&timeinfo) && tries < 20) {
    delay(500);
    Serial.print(".");
    tries++;
  }
  if (getLocalTime(&timeinfo)) {
    Serial.println(" OK");
    char buf[32];
    strftime(buf, sizeof(buf), "%Y-%m-%d %H:%M:%S", &timeinfo);
    Serial.print("Current time: ");
    Serial.println(buf);
  } else {
    Serial.println(" FAILED");
  }
}

// ── Wi-Fi ─────────────────────────────────────────────────────────────────────
void connectWifi() {
  tft.fillScreen(GB_BG);
  tft.setTextColor(GB_INK, GB_BG);
  tft.setTextDatum(MC_DATUM);
  tft.drawString("Connecting Wi-Fi", SCR_W / 2, SCR_H / 2, 2);

  Serial.begin(115200);
  delay(500);
  Serial.print("Connecting to: ");
  Serial.println(WIFI_SSID);

  WiFi.mode(WIFI_STA);

  // Scan for networks first so you can see what's visible and at what signal strength
  Serial.println("Scanning for networks...");
  int n = WiFi.scanNetworks();
  Serial.print(n); Serial.println(" networks found:");
  for (int i = 0; i < n; i++) {
    Serial.print("  ["); Serial.print(i); Serial.print("] ");
    Serial.print(WiFi.SSID(i));
    Serial.print("  signal: "); Serial.print(WiFi.RSSI(i));
    Serial.print(" dBm  ch:"); Serial.print(WiFi.channel(i));
    Serial.println(WiFi.encryptionType(i) == WIFI_AUTH_OPEN ? "  OPEN" : "  secured");
  }
  Serial.println();

  Serial.print("Connecting to: ["); Serial.print(WIFI_SSID); Serial.println("]");
  WiFi.begin(WIFI_SSID, WIFI_PASS);

  int tries = 0;
  while (WiFi.status() != WL_CONNECTED) {
    delay(500);
    Serial.print("Status: "); Serial.println(WiFi.status());
    tries++;
    if (tries > 20) {
      Serial.println("Still not connected after 10s. Rescanning...");
      int m = WiFi.scanNetworks();
      for (int i = 0; i < m; i++) {
        Serial.print("  "); Serial.print(WiFi.SSID(i));
        Serial.print(" ("); Serial.print(WiFi.RSSI(i)); Serial.println(" dBm)");
      }
      tries = 0;
    }
  }
  Serial.println("\nCONNECTED!");
  syncTime();
}

// ── Fetch scores ──────────────────────────────────────────────────────────────
void fetchScores() {
  struct tm timeinfo;
  if (!getLocalTime(&timeinfo)) {
    Serial.println("Clock not set -- skipping fetch");
    return;
  }
  char dateStr[9];
  strftime(dateStr, sizeof(dateStr), "%Y%m%d", &timeinfo);
  char url[120];
  snprintf(url, sizeof(url),
    "http://site.api.espn.com/apis/site/v2/sports/soccer/fifa.world/scoreboard?dates=%s",
    dateStr);

  Serial.print("Fetching: ");
  Serial.println(url);

  WiFiClient client;
  HTTPClient https;
  if (!https.begin(client, url)) return;

  int code = https.GET();
  Serial.print("HTTP status: ");
  Serial.println(code);
  if (code != HTTP_CODE_OK) { https.end(); return; }

  // We have ~200KB free heap. Read the full payload into a buffer,
  // strip any chunk-size headers, then parse. This is reliable across
  // all ESP32 Arduino HTTP client versions.

  // Collect payload — HTTPClient's internal chunked decoder works correctly
  // when we use getStream() + readBytesUntilTimeout rather than getString().
  // We allocate 90KB which fits comfortably in the available heap.
  const int BUF_SIZE = 92000;
  char* buf = (char*)ps_malloc(BUF_SIZE);   // try PSRAM first
  if (!buf) buf = (char*)malloc(BUF_SIZE);  // fall back to regular heap
  if (!buf) { Serial.println("malloc failed"); https.end(); return; }

  // Use HTTPClient's writeToStream to write into a temporary stream,
  // OR just read directly. The simplest: read via getStream() with timeout.
  WiFiClient* rawStream = https.getStreamPtr();
  int total = 0;
  uint32_t deadline = millis() + 12000;
  while (millis() < deadline && total < BUF_SIZE - 1) {
    int av = rawStream->available();
    if (av > 0) {
      int rd = rawStream->readBytes(buf + total, min(av, BUF_SIZE - total - 1));
      total += rd;
      deadline = millis() + 3000;
    } else if (!rawStream->connected()) {
      break;
    } else {
      delay(2);
    }
  }
  buf[total] = '\0';
  https.end();

  // Chunk headers look like "1A2B\r\n" before JSON data.
  // Find the first { or [ to skip them.
  char* js = buf;
  int skipped = 0;
  while (*js && *js != '{' && *js != '[') { js++; skipped++; }
  Serial.print("Skipped "); Serial.print(skipped); Serial.println(" header bytes");
  if (!*js) { free(buf); Serial.println("No JSON found"); return; }

  // Strip chunk boundaries IN-PLACE inside buf — no second allocation needed.
  // Chunked encoding inserts \r\nSIZE\r\n between chunks inside the JSON body.
  // We compact the buffer by reading from js (src) and writing back to js (dst).
  if (skipped > 0) {
    char* src = js;
    char* dst = js;
    int cleaned = 0;
    while (*src) {
      if (src[0] == '\r' && src[1] == '\n') {
        char* p = src + 2;
        while (*p && ((*p>='0'&&*p<='9')||(*p>='a'&&*p<='f')||(*p>='A'&&*p<='F'))) p++;
        if (p > src+2 && p[0]=='\r' && p[1]=='\n') {
          src = p + 2;  // skip the chunk boundary
          cleaned++;
          continue;
        }
      }
      *dst++ = *src++;
    }
    *dst = '\0';
  }
  char* clean = js;  // js is now chunk-free, in-place

  StaticJsonDocument<2048> filter;
  JsonObject ef = filter["events"].createNestedObject();
  ef["status"]["type"]["state"]       = true;
  ef["status"]["type"]["shortDetail"] = true;
  ef["status"]["type"]["detail"]      = true;
  ef["status"]["displayClock"]        = true;
  ef["altGameNote"]                   = true;
  JsonObject cf = ef["competitions"].createNestedObject();
  cf["venue"]["address"]["city"]    = true;
  cf["venue"]["address"]["country"] = true;
  JsonObject tf = cf["competitors"].createNestedObject();
  tf["homeAway"]            = true;
  tf["score"]               = true;
  tf["team"]["displayName"] = true;
  tf["team"]["id"]          = true;
  JsonObject df = cf["details"].createNestedObject();
  df["type"]["text"]                                       = true;
  df["clock"]["displayValue"]                              = true;
  df["team"]["id"]                                         = true;
  df["athletesInvolved"].createNestedObject()["shortName"] = true;

  // Parse with filter into a modest document.
  // The filter discards >95% of the payload before it touches the doc.
  // 16KB is enough for up to ~8 filtered events.
  DynamicJsonDocument doc(32768);
  DeserializationError err = deserializeJson(doc, clean,
      DeserializationOption::Filter(filter));
  // Free buffers — doc has copied all needed string data
  free(buf);  // clean points into buf, so just free buf
  if (err) {
    Serial.print("JSON error: "); Serial.println(err.c_str());
    return;
  }

  JsonArray events = doc["events"].as<JsonArray>();
  Serial.print("Events in feed: "); Serial.println(events.size());

  int liveCount = 0;
  for (JsonObject event : events) {
    if (strcmp(event["status"]["type"]["state"] | "pre", "in") == 0) liveCount++;
  }

  int newMatchCount = 0;

  for (JsonObject event : events) {
    if (newMatchCount >= 16) break;

    const char* state      = event["status"]["type"]["state"]       | "pre";
    const char* shortDetail= event["status"]["type"]["shortDetail"]  | "";
    const char* longDetail = event["status"]["type"]["detail"]       | "";
    const char* clk        = event["status"]["displayClock"]         | "";
    const char* group      = event["altGameNote"]                    | "";

    bool isLive      = strcmp(state, "in")   == 0;
    bool isFinished  = strcmp(state, "post") == 0;
    bool isScheduled = strcmp(state, "pre")  == 0;

    if (liveCount > 0 && !isLive) continue;

    JsonObject comp = event["competitions"][0];
    const char* city    = comp["venue"]["address"]["city"]    | "";
    const char* country = comp["venue"]["address"]["country"] | "";

    char venueStr[40];
    if (strlen(city) > 0) {
      if (strchr(city, ',')) {
        strncpy(venueStr, city, sizeof(venueStr) - 1);
      } else if (strlen(country) > 0 &&
                 strcmp(country, "USA") != 0 && strcmp(country, "US") != 0) {
        snprintf(venueStr, sizeof(venueStr), "%s, %s", city, country);
      } else {
        strncpy(venueStr, city, sizeof(venueStr) - 1);
      }
    } else {
      strncpy(venueStr, country, sizeof(venueStr) - 1);
    }
    venueStr[sizeof(venueStr) - 1] = '\0';

    const char *homeName = "?", *awayName = "?";
    const char *homeSc   = "0", *awaySc   = "0";
    const char *homeId   = "",  *awayId   = "";

    for (JsonObject t : comp["competitors"].as<JsonArray>()) {
      bool home = strcmp(t["homeAway"] | "", "home") == 0;
      if (home) {
        homeName = t["team"]["displayName"] | "?"; homeSc = t["score"] | "0";
        homeId   = t["team"]["id"]          | "";
      } else {
        awayName = t["team"]["displayName"] | "?"; awaySc = t["score"] | "0";
        awayId   = t["team"]["id"]          | "";
      }
    }

    Match& m = matches[newMatchCount];
    int newHome = atoi(homeSc);
    int newAway = atoi(awaySc);

    bool goalScored = false;
    char latestScorer[22] = "";
    if (newMatchCount < matchCount) {
      if ((newHome > m.prevHomeScore || newAway > m.prevAwayScore) && isLive)
        goalScored = true;
    }

    m.prevHomeScore = newHome;
    m.prevAwayScore = newAway;
    m.scorerCount   = 0;
    m.live          = isLive;
    m.finished      = isFinished;
    m.scheduled     = isScheduled;

    strncpy(m.homeName, homeName, sizeof(m.homeName) - 1);
    m.homeName[sizeof(m.homeName) - 1] = '\0';
    stripDiacritics(m.homeName);
    for (char* p = m.homeName; *p; p++) *p = toupper(*p);

    strncpy(m.awayName, awayName, sizeof(m.awayName) - 1);
    m.awayName[sizeof(m.awayName) - 1] = '\0';
    stripDiacritics(m.awayName);
    for (char* p = m.awayName; *p; p++) *p = toupper(*p);

    strncpy(m.homeScore, homeSc, sizeof(m.homeScore) - 1);
    m.homeScore[sizeof(m.homeScore) - 1] = '\0';
    strncpy(m.awayScore, awaySc, sizeof(m.awayScore) - 1);
    m.awayScore[sizeof(m.awayScore) - 1] = '\0';

    if (isLive && strlen(clk) > 0) {
      strncpy(m.clock, clk, sizeof(m.clock) - 1);
      bool hasAp = false;
      for (int i = 0; m.clock[i]; i++) if (m.clock[i] == '\'') hasAp = true;
      if (!hasAp && isdigit(m.clock[0])) {
        int len = strlen(m.clock);
        if (len < (int)sizeof(m.clock) - 1) {
          m.clock[len] = '\''; m.clock[len+1] = '\0';
        }
      }
    } else if (isScheduled) {
      const char* atPtr = strstr(longDetail, "at ");
      if (atPtr) strncpy(m.clock, atPtr + 3, sizeof(m.clock) - 1);
      else        strncpy(m.clock, shortDetail, sizeof(m.clock) - 1);
    } else {
      strncpy(m.clock, shortDetail, sizeof(m.clock) - 1);
    }
    m.clock[sizeof(m.clock) - 1] = '\0';

    const char* gPtr = strstr(group, "Group");
    strncpy(m.group, gPtr ? gPtr : group, sizeof(m.group) - 1);
    m.group[sizeof(m.group) - 1] = '\0';

    strncpy(m.venue, venueStr, sizeof(m.venue) - 1);
    m.venue[sizeof(m.venue) - 1] = '\0';

    for (JsonObject det : comp["details"].as<JsonArray>()) {
      if (m.scorerCount >= MAX_SCORERS) break;
      const char* typeText = det["type"]["text"] | "";
      bool isGoal    = strncmp(typeText, "Goal", 4) == 0 && strstr(typeText, "Own") == NULL;
      bool isOwnGoal = strstr(typeText, "Own Goal") != NULL;
      if (!isGoal && !isOwnGoal) continue;

      const char* sTime  = det["clock"]["displayValue"] | "";
      const char* teamId = det["team"]["id"]            | "";

      if (isOwnGoal) {
        const char* sName = "";
        JsonArray ath = det["athletesInvolved"].as<JsonArray>();
        if (ath.size() > 0) sName = ath[0]["shortName"] | "";
        char ogName[22];
        snprintf(ogName, sizeof(ogName), "OG (%s)", sName);
        strncpy(m.scorerName[m.scorerCount], ogName, 21);
      } else {
        const char* sName = "";
        JsonArray ath = det["athletesInvolved"].as<JsonArray>();
        if (ath.size() > 0) sName = ath[0]["shortName"] | "";
        strncpy(m.scorerName[m.scorerCount], sName, 21);
        strncpy(latestScorer, sName, 21);
      }
      m.scorerName[m.scorerCount][21] = '\0';
      stripDiacritics(m.scorerName[m.scorerCount]);
      snprintf(m.scorerTime[m.scorerCount], sizeof(m.scorerTime[0]), "%s", sTime);
      m.scorerHome[m.scorerCount] = strcmp(teamId, homeId) == 0;
      m.scorerCount++;
    }

    if (goalScored) {
      stripDiacritics(latestScorer);
      showIdx = newMatchCount;
      playGoalAnimation(latestScorer);
    }

    Serial.print("  ");
    Serial.print(m.awayName); Serial.print(" ");
    Serial.print(m.awayScore); Serial.print("-");
    Serial.print(m.homeScore); Serial.print(" ");
    Serial.print(m.homeName); Serial.print("  ");
    Serial.print(m.clock); Serial.print("  scorers:");
    Serial.println(m.scorerCount);

    newMatchCount++;
  }

  matchCount = newMatchCount;
  Serial.print(matchCount); Serial.println(" matches displayed.");
}

// ── Draw scoreboard ───────────────────────────────────────────────────────────
void drawMatch() {
  tft.fillScreen(GB_BG);

  if (matchCount == 0) {
    tft.setTextColor(GB_INK, GB_BG);
    tft.setTextDatum(MC_DATUM);
    tft.drawString("No games today", SCR_W / 2, SCR_H / 2, 4);
    return;
  }

  Match& m = matches[showIdx];

  // Header
  tft.fillRect(0, 0, SCR_W, HDR_H, GB_DARK);
  tft.setTextColor(GB_INK, GB_DARK);
  tft.setTextDatum(MC_DATUM);
  tft.drawString("WORLD CUP 2026", SCR_W / 2, HDR_H / 2, 2);
  tft.setTextColor(GB_DIM2, GB_DARK);
  tft.setTextDatum(ML_DATUM);
  tft.drawString(m.group, 4, HDR_H / 2, 1);
  tft.setTextColor(m.live ? GB_INK : GB_DIM2, GB_DARK);
  tft.setTextDatum(MR_DATUM);
  tft.drawString(m.clock, SCR_W - 4, HDR_H / 2, 2);

  // Away panel
  tft.fillRect(0, PANEL_Y, 152, PANEL_H, GB_DARK);
  tft.setTextColor(GB_INK, GB_DARK);
  tft.setTextDatum(TC_DATUM);
  tft.drawString(m.awayName, 76, PANEL_Y + 6, 2);
  tft.setTextDatum(MC_DATUM);
  // For scheduled games show '-' instead of '0'
  tft.drawString(m.scheduled ? "-" : m.awayScore, 76, PANEL_Y + 60, 7);

  // Home panel
  tft.fillRect(168, PANEL_Y, 152, PANEL_H, GB_DARK);
  tft.setTextColor(GB_INK, GB_DARK);
  tft.setTextDatum(TC_DATUM);
  tft.drawString(m.homeName, 244, PANEL_Y + 6, 2);
  tft.setTextDatum(MC_DATUM);
  tft.drawString(m.scheduled ? "-" : m.homeScore, 244, PANEL_Y + 60, 7);

  // Dash separator between panels
  tft.setTextColor(GB_DIM2, GB_BG);
  tft.setTextDatum(MC_DATUM);
  tft.drawString("-", SCR_W / 2, PANEL_Y + 60, 4);

  // Scorers panel
  tft.fillRect(0, SCORER_Y, SCR_W, SCORER_H, GB_DARK);
  tft.drawFastVLine(SCR_W / 2, SCORER_Y, SCORER_H, GB_DIM2);

  if (m.scorerCount == 0) {
    tft.setTextColor(GB_DIM2, GB_DARK);
    tft.setTextDatum(MC_DATUM);
    if (m.live)      tft.drawString("No goals yet", SCR_W / 2, SCORER_Y + SCORER_H / 2, 1);
    if (m.scheduled) tft.drawString("Kick-off: " + String(m.clock), SCR_W / 2, SCORER_Y + SCORER_H / 2, 1);
  } else {
    const int lineH  = 13;
    const int startY = SCORER_Y + 8;
    const int maxY   = SCORER_Y + SCORER_H - 4;
    int awayY = startY, homeY = startY;
    for (int i = 0; i < m.scorerCount; i++) {
      char buf[32];
      snprintf(buf, sizeof(buf), "%s %s", m.scorerName[i], m.scorerTime[i]);
      if (!m.scorerHome[i] && awayY + lineH <= maxY) {
        tft.setTextColor(GB_INK, GB_DARK);
        tft.setTextDatum(ML_DATUM);
        tft.drawString(buf, 4, awayY, 1);
        awayY += lineH;
      } else if (m.scorerHome[i] && homeY + lineH <= maxY) {
        tft.setTextColor(GB_INK, GB_DARK);
        tft.setTextDatum(MR_DATUM);
        tft.drawString(buf, SCR_W - 4, homeY, 1);
        homeY += lineH;
      }
    }
  }

  // Footer
  tft.fillRect(0, FOOTER_Y, SCR_W, FOOTER_H, GB_DARK);
  tft.setTextColor(GB_DIM2, GB_DARK);
  tft.setTextDatum(MC_DATUM);
  tft.drawString(m.venue, SCR_W / 2, FOOTER_Y + FOOTER_H / 2, 2);

  // Progress dots
  if (matchCount > 1) {
    int dotY    = SCORER_Y - 4;
    int spacing = 12;
    int startX  = SCR_W / 2 - (matchCount - 1) * spacing / 2;
    for (int i = 0; i < matchCount; i++) {
      tft.fillCircle(startX + i * spacing, dotY,
                     i == showIdx ? 3 : 2,
                     i == showIdx ? GB_INK : GB_DIM2);
    }
  }
}

// ── Setup ─────────────────────────────────────────────────────────────────────
void setup() {
  tft.init();
  tft.setRotation(1);
  precomputeArc();
  connectWifi();

#if TEST_ANIMATION
  delay(500);
  // Show a dummy scoreboard first so the arc has something to travel over
  matchCount = 1;
  strncpy(matches[0].homeName, "PORTUGAL", 23);
  strncpy(matches[0].awayName, "UZBEKISTAN", 23);
  strncpy(matches[0].homeScore, "1", 3);
  strncpy(matches[0].awayScore, "0", 3);
  strncpy(matches[0].clock, "23'", 9);
  strncpy(matches[0].group, "Group K", 15);
  strncpy(matches[0].venue, "Houston", 39);
  matches[0].live = true;
  matches[0].finished = false;
  matches[0].scheduled = false;
  matches[0].scorerCount = 0;
  matches[0].prevHomeScore = 0;
  matches[0].prevAwayScore = 0;
  showIdx = 0;
  playGoalAnimation("C. Ronaldo");
  matchCount = 0;  // reset so real fetch populates correctly
#endif
}

// ── Loop ──────────────────────────────────────────────────────────────────────
void loop() {
  uint32_t now = millis();

  if (lastFetch == 0 || now - lastFetch > FETCH_EVERY_MS) {
    if (WiFi.status() == WL_CONNECTED) fetchScores();
    lastFetch  = now;
    showIdx    = 0;
    lastRotate = now;
    drawMatch();
  }

  if (matchCount > 1 && now - lastRotate > ROTATE_EVERY_MS) {
    showIdx = (showIdx + 1) % matchCount;
    lastRotate = now;
    drawMatch();
  }
}
